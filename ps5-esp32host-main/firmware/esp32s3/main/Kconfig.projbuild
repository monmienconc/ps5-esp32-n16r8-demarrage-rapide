## ps5-esp32host-main/firmware/esp32s3/main/Kconfig.projbuild
```kconfig
menu "PS5 offline host"
    config PS5_AP_SSID
        string "Wi-Fi network name"
        default "PS5-Host"
    config PS5_AP_PASSWORD
        string "Wi-Fi password (8 to 63 characters)"
        default "ps5offline"
    config PS5_AP_CHANNEL
        int "Wi-Fi channel"
        range 1 11
        default 6
endmenu
```

## ps5-esp32host-main/firmware/esp32s3/sdkconfig.defaults
```kconfig
CONFIG_IDF_TARGET="esp32s3"
CONFIG_ESPTOOLPY_FLASHSIZE_16MB=y
CONFIG_ESPTOOLPY_FLASHMODE_QIO=y
CONFIG_ESPTOOLPY_FLASHFREQ_80M=y
CONFIG_PARTITION_TABLE_CUSTOM=y
CONFIG_PARTITION_TABLE_CUSTOM_FILENAME="partitions.csv"
CONFIG_SPIRAM=y
CONFIG_SPIRAM_MODE_OCT=y
CONFIG_SPIRAM_SPEED_80M=y
CONFIG_SPIRAM_USE_MALLOC=y
CONFIG_SPIRAM_MEMTEST=y
CONFIG_ESP_DEFAULT_CPU_FREQ_MHZ_240=y
CONFIG_SPIFFS_OBJ_NAME_LEN=128
CONFIG_SPIFFS_CACHE=y
CONFIG_LWIP_MAX_SOCKETS=16
CONFIG_HTTPD_MAX_REQ_HDR_LEN=2048
CONFIG_HTTPD_MAX_URI_LEN=256
CONFIG_ESP_MAIN_TASK_STACK_SIZE=6144
CONFIG_ESP_CONSOLE_USB_SERIAL_JTAG=y
```
